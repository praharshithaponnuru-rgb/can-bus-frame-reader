VERSION ""

NS_ :

BS_:

BU_: ECU TESTER

BO_ 256 ENGINE_DATA: 8 ECU
 SG_ EngineRPM : 0|16@1+ (1,0) [0|8000] "rpm" TESTER
 SG_ CoolantTemp : 16|8@1+ (1,-40) [-40|215] "degC" TESTER

BO_ 512 SPEED_DATA: 8 ECU
 SG_ VehicleSpeed : 0|16@1+ (0.01,0) [0|250] "km/h" TESTER

CM_ BO_ 256 "Engine RPM and coolant temperature.";
CM_ BO_ 512 "Vehicle road speed.";
